## apps/helloworld/Kconfig
```kconfig
config EXAMPLE_HELLOWORLD
	string "String to Echo"
	default "hello world"

config EXAMPLE_INTERVAL
	int "Interval in milliseconds"
	default 1000
	range 100 10000
```

## apps/m0_lowload/Kconfig
```kconfig
config LL_IRQFWD_SDH
	bool "Enable IRQ forwarding for SDH"
	default y

config LL_IRQFWD_UART2
	bool "Enable IRQ forwarding for UART2"
	default y

config LL_IRQFWD_USB
	bool "Enable IRQ forwarding for USB"
	default n
```

## bsp/common/Kconfig
```kconfig
osource "$(BFLB_BOARD_DIR)/$(BFLB_BOARD)/Kconfig"
osource "$(BFLB_BOARD_DIR)/common/$(BFLB_CHIP)/Kconfig"
comment "Generic BSP Config"
menuconfig JTAG_DEBUG
    bool "JTAG debug support"
    help
        This option enables JTAG debug module and pins.

    if JTAG_DEBUG
        if CHIP_BL808
            choice
                prompt "CPU To attach JTAG Debug Socket to"
                default JTAG_DEBUG_M0
                help
                    Select the core to attach the JTAG Debug Socket to.
                config JTAG_DEBUG_M0
                    bool "Debug M0 Core"
                config JTAG_DEBUG_D0
                    bool "Debug D0 Core"
                config JTAG_DEBUG_LP
                    bool "Debug LP Core"
            endchoice
        endif
        choice
            prompt "JTAG Debug Pins"
            default JTAG_DEBUG_PINS_GRP0 if BOARD_OX64
            default JTAG_DEBUG_PINS_GRP1 if BOARD_M1S_DOCK
            help
                Select the JTAG Debug Pins to use.
            config JTAG_DEBUG_PINS_GRP0
                bool "JTAG Debug Pins Group 0"
                help
                    JTAG Debug Pins are on:
                    - JTAG_TMS on GPIO6
                    - JTAG_TDO on GPIO7
                    - JTAG_TCK on GPIO12
                    - JTAG_TDI on GPIO13
                    This is the default debug header on the OX64 board

            config JTAG_DEBUG_PINS_GRP1
                bool "JTAG Debug Pins Group 1"
                help
                    JTAG Debug Pins are on:
                    - JTAG_TMS on GPIO0
                    - JTAG_TDO on GPIO1
                    - JTAG_TCK on GPIO2
                    - JTAG_TDI on GPIO3
                    This configuration is used on the M1S Dock board
                    with the tf2jtag adapter board. 
        endchoice
    endif
menu "Pinmux"
    if BOARD_HAS_SDCARD
        config PINMUX_ENABLE_SDH
            bool "Enable SD Card Pinmux and Clock"
            default y
            help
                Enable SD Card Pinmux and Clocks
    endif
endmenu
```

## bsp/common/bl616/Kconfig
```kconfig
comment "BL616 SOC"

config CHIP_BL616
    bool
    default y if BFLB_CHIP_ID = "bl616"

menu "BL616 CPU Config"
endmenu
```

## bsp/common/bl702/Kconfig
```kconfig
comment "BL702 SOC"

config CHIP_BL708
    bool
    default y if BFLB_CHIP_ID = "bl702"

menu "BL702 CPU Config"
endmenu
```

## bsp/common/bl808/Kconfig
```kconfig
comment "BL808 $(BFLB_CPU_ID) SOC"

config CHIP_BL808
    bool
    default y if BFLB_CHIP = "bl808"

config CPU_M0
	bool
	default y if BFLB_CPU_ID = "m0"
config CPU_D0
	bool
	default y if BFLB_CPU_ID = "d0"
config CPU_LP
	bool
	default y if BFLB_CPU_ID = "lp"


menu "M0 CPU Config"
    visible if CPU_M0
    menu "Pinmux"
        if BOARD_HAS_SDCARD
            config PINMUX_ENABLE_SDH
                bool "Enable SD Card Pinmux and Clock"
                default y
                help
                    Enable SD Card Pinmux and Clocks
        endif
    endmenu
endmenu
menu "D0 CPU Config"
    visible if CPU_D0
endmenu
menu "LP CPU Config"
    visible if CPU_LP
endmenu
```

## bsp/m0sdock/Kconfig
```kconfig
config BOARD_M0SDOCK
    bool
    default y if BFLB_BOARD = "m0sdock"

comment "M0S Dock Options"

menu "Pinmux Configuration"
    config PINMUX_ENABLE_LED1
        bool "Enable LED1 Pinmux"
        default y
        help
            Enable LED1 Pinmux
    config PINMUX_ENABLE_LED2
        bool "Enable LED1 Pinmux"
        default y
        help
            Enable LED1 Pinmux

endmenu
```

## bsp/m0sense/Kconfig
```kconfig
config BOARD_M0SENSE
    bool
    default y if BFLB_BOARD = "m0sense"

comment "M0Sense Options"

menu "Pinmux Configuration"
    config PINMUX_ENABLE_LED1
        bool "Enable LED1 Pinmux (Red)"
        default y
        help
            Enable LED1 Pinmux
    config PINMUX_ENABLE_LED2
        bool "Enable LED2 Pinmux (Green) - Currently Broken"
        default n
        help
            Enable LED2 Pinmux. Currently Broken. Need to investigate.
    config PINMUX_ENABLE_LED3
        bool "Enable LED3 Pinmux (Blue)"
        default y
        help
            Enable LED3 Pinmux
    config PINMUX_ENABLE_BTN1
        bool "Enable Boot Button"
        default y
        help
            Enable Boot Button
endmenu
```

## bsp/m1sdock/Kconfig
```kconfig
config BOARD_M1SDOCK
    bool
    default y if BFLB_BOARD = "m1sdock"

config BOARD_HAS_SDCARD
    bool
    default y if BFLB_BOARD = "m1sdock"

comment "M1S Dock Options"

menu "Pinmux Configuration"
    config PINMUX_ENABLE_BTN1
        bool "Enable Button1 Pinmux"
        default y
        help
            Enable Button1 Pinmux
    config PINMUX_ENABLE_BTN2
        bool "Enable Button2 Pinmux"
        default y
        help
            Enable Button2 Pinmux
    config PINMUX_ENABLE_LED1
        bool "Enable LED1 Pinmux"
        default y
        help
            Enable LED1 Pinmux
endmenu
```

## bsp/ox64/Kconfig
```kconfig
config BOARD_OX64
    bool
    default y if BFLB_BOARD = "ox64"

config BOARD_HAS_SDCARD
    bool
    default y if BFLB_BOARD = "ox64"

comment "ox64 Options"
```

## components/indicator/Kconfig
```kconfig
config COMPONENT_STATUS_LED
    bool "Status Led Component"
    default n
    select COMPONENT_SYSTEM
    help
        "Status Led Component from esp-iot-solution modified for Bouffalo MCU SDK"
```

## components/mailbox/Kconfig
```kconfig
config COMPONENT_MAILBOX
    bool "Mailbox Support for Linux"
    default y if BFLB_CHIP = "bl808"
    help
        Mailbox Component forwards IRQ's to the D0 core for Linux
        support. Enable this component if you are running linux on 
        the D0 core.

        Please see the README.md file in the Mailbox component directory
        for more information

menu "Mailbox Configuration"
    visible if COMPONENT_MAILBOX
    config COMPONENT_MAILBOX_IRQFWD_SDH
	bool "Enable IRQ forwarding for SDH"
	default y

config COMPONENT_MAILBOX_IRQFWD_UART2
	bool "Enable IRQ forwarding for UART2"
	default n
    help
        Enable if you wish to use UART2 for linux

config COMPONENT_MAILBOX_IRQFWD_USB
	bool "Enable IRQ forwarding for USB"
	default n
    help
        Curently disabled as USB is not working

config COMPONENT_MAILBOX_USB_HOST
        depends on COMPONENT_MAILBOX_IRQFWD_USB
        bool "Set USB to HOST mode"
        default n
    help
        By default USB operates in peripheral mode. Set this to use the
        USB adapter as a host device.

config COMPONENT_MAILBOX_IRQFWD_GPIO
    bool "Enable IRQ forwarding for GPIO"
    default y
    help
        enable if you need Interupt Support for GPIO on Linux
        
config COMPONENT_MAILBOX_IRQFWD_EMAC
    bool "Enable IRQ forwarding for Ethernet"
    default y if BOARD_M1SDOCK
    default n
    help
        enable if you need Interupt Support for Ethernet on Linux
        Currently supported on M1SDock to to vddio2 being 
        wrong voltage for OX64
endmenu
```

## components/nvkvs/Kconfig
```kconfig
config COMPONENT_NVKVS
    bool "Non-Volatile Key-Value Storage Component"
    default n
    select COMPONENT_SYSTEM
    help
        Non-Volatile Key-Value Storage Component

menu "NVKVS Configuration"
    visible if COMPONENT_NVKVS
    config COMPONENT_NVKVS_MEM_BACKEND
        bool "Use memory backend"
        default y
        help
            Use memory backend
    config COMPONENT_NVKVS_FLASH_BACKEND
        bool "Use flash backend"
        default y
        help
            Use flash backend
    config COMPONENT_NVKVS_MAX_STRING_SIZE
        int "Maximum String Size that can be stored in NVKVS"
        default 64
        range 8 256
        help
            The Maximum String Size that can be stored in a Key
endmenu
```

## components/oblfr/Kconfig
```kconfig
config COMPONENT_SYSTEM
    bool "System Component"
    default n
    select FREERTOS
    help
        "System Component - Initializes FreeRTOS and any selected optional components"
menu "System Configuration"
    visible if COMPONENT_SYSTEM
    config COMPONENT_SYSTEM_MAIN_TASK_STACK_SIZE
        int "Main Task Stack Size"
        default 4096
        help
            "Stack Size For the app_main task"
    config COMPONENT_SYSTEM_MAIN_TASK_PRIORITY
        int "Main Task Priority"
        default 5
        help
            "Main Task Priority"
    config COMPONENT_SYSTEM_DEFAULT_STACK_SIZE
        int "Default Stack Size"
        default 1024
        help
            "Default Stack Size"
    config COMPONENT_SYSTEM_RUNTIME_STATS
        bool "FreeRTOS RunTime Stats"
        default y
        help
            "FreeRTOS RunTime Stats"
    config COMPONENT_SYSTEM_TIMER_STACK_SIZE
        int "FreeRTOS Timer Task Stack Size"
        default 1024
        help
            "FreeRTOS Timer Task Stack Size. This is not the same as the oblfr_timer component"
    choice 
        prompt "Check Stack Overflow"
        default COMPONENT_SYSTEM_CHECK_STACK_OVERFLOW_NONE
        config COMPONENT_SYSTEM_CHECK_STACK_OVERFLOW_NONE
            bool "None"
        config COMPONENT_SYSTEM_CHECK_STACK_OVERFLOW_SIZE
            bool "Check if the Stack Space has overflowed at Context Switches"
        config COMPONENT_SYSTEM_CHECK_STACK_OVERFLOW_CANARY_GUARD
            bool "Place 16 Canary Guard Bytes at top of stack and check at Context Switch" 
    endchoice
    config COMPONENT_SYSTEM_CHECK_STACK_OVERFLOW
        int
        default 0 if COMPONENT_SYSTEM_CHECK_STACK_OVERFLOW_NONE
        default 1 if COMPONENT_SYSTEM_CHECK_STACK_OVERFLOW_SIZE
        default 2 if COMPONENT_SYSTEM_CHECK_STACK_OVERFLOW_CANARY_GUARD
endmenu
```

## components/rpmsg/Kconfig
```kconfig
config COMPONENT_RPMSG
    bool "RPmsg Component"
    default n
    select COMPONENT_SYSTEM
    help
        RPmsg Component to allow inter core communication
        works with bare metal and linux

menu "RPMsg Configuration"
    visible if COMPONENT_RPMSG
endmenu
```

## components/timer/Kconfig
```kconfig
config COMPONENT_TIMER
    bool "Timer Component"
    default n
    select COMPONENT_SYSTEM
    help
        "Timer Component"
menu "Timer Configuration"
    visible if COMPONENT_TIMER

endmenu
```

## components/usbphy/Kconfig
```kconfig
config COMPONENT_USBPHY
    bool "USBPHY Support for Linux"
    default y
    help
        This initialize the power supply for the USB chip. Enable this
	component if you are running linux on the D0 core and want to have
	working USB

        Please see the README.md file in the usbphy component directory
        for more information
```
